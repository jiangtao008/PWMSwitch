/**
 * @file    ssd1306.c
 * @brief   SSD1306 128×64 I2C OLED driver with framebuffer.
 *
 * I2C2: PB10=SCL, PB11=SDA, 400 kHz, 7-bit addr 0x3C.
 */

#include "ssd1306.h"
#include "stm32f1xx_hal.h"

/* ── I2C config ───────────────────────────────────────────────────── */
#define I2C_ADDR       (0x3C << 1)   /* 8-bit shifted address */

/* ── Framebuffer ──────────────────────────────────────────────────── */
static uint8_t fb[SSD1306_WIDTH * SSD1306_HEIGHT / 8];  /* 1024 bytes */
static I2C_HandleTypeDef hi2c2;

/* ── 8×8 font: ASCII 32~127 ──────────────────────────────────────── */
static const uint8_t font8x8[96][8] = {
    {0x00,0x00,0x00,0x00,0x00,0x00,0x00,0x00}, /* ' '  32 */
    {0x00,0x06,0x5E,0x06,0x00,0x00,0x00,0x00}, /* '!'  33 */
    {0x00,0x07,0x00,0x07,0x00,0x00,0x00,0x00}, /* '"'  34 */
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    {0x08,0x04,0x08,0x10,0x08,0x00,0x00,0x00}, /* '~' 126 */
};

/* ── I2C helpers ──────────────────────────────────────────────────── */
static void i2c_write_cmd(uint8_t byte)
{
    uint8_t buf[2] = {0x00, byte};   /* Co=0, D/C#=0 → command */
    HAL_I2C_Master_Transmit(&hi2c2, I2C_ADDR, buf, 2, 10);
}

static void i2c_write_data_buf(const uint8_t *data, uint16_t len)
{
    /* HAL limits single transfer.  Use a small stack buffer with Co+D/C byte. */
    uint8_t tmp[129];   /* 1 prefix + max 128 */
    while (len) {
        uint16_t chunk = (len > 128) ? 128 : len;
        tmp[0] = 0x40;   /* Co=0, D/C#=1 → data */
        for (uint16_t i = 0; i < chunk; i++) tmp[i + 1] = data[i];
        HAL_I2C_Master_Transmit(&hi2c2, I2C_ADDR, tmp, chunk + 1, 100);
        data += chunk;
        len  -= chunk;
    }
}

/* ── Public API ───────────────────────────────────────────────────── */

void SSD1306_Init(void)
{
    /* ── GPIO: PB10=SCL, PB11=SDA ── */
    __HAL_RCC_GPIOB_CLK_ENABLE();
    __HAL_RCC_I2C2_CLK_ENABLE();

    GPIO_InitTypeDef g = {0};
    g.Mode  = GPIO_MODE_AF_OD;
    g.Pull  = GPIO_PULLUP;
    g.Speed = GPIO_SPEED_FREQ_HIGH;
    g.Pin   = GPIO_PIN_10 | GPIO_PIN_11;
    HAL_GPIO_Init(GPIOB, &g);

    hi2c2.Instance             = I2C2;
    hi2c2.Init.ClockSpeed      = 400000;
    hi2c2.Init.DutyCycle       = I2C_DUTYCYCLE_2;
    hi2c2.Init.OwnAddress1     = 0;
    hi2c2.Init.AddressingMode  = I2C_ADDRESSINGMODE_7BIT;
    hi2c2.Init.DualAddressMode = I2C_DUALADDRESS_DISABLE;
    hi2c2.Init.GeneralCallMode = I2C_GENERALCALL_DISABLE;
    hi2c2.Init.NoStretchMode   = I2C_NOSTRETCH_DISABLE;
    HAL_I2C_Init(&hi2c2);

    /* ── SSD1306 init sequence ─────────────────────────────── */
    HAL_Delay(200);       /* wait for OLED module power-up */

    i2c_write_cmd(0xAE);   /* display off */
    i2c_write_cmd(0xD5);   /* clock div */
    i2c_write_cmd(0x80);
    i2c_write_cmd(0xA8);   /* multiplex */
    i2c_write_cmd(0x3F);   /* 64 */
    i2c_write_cmd(0xD3);   /* display offset */
    i2c_write_cmd(0x00);
    i2c_write_cmd(0x40);   /* start line = 0 */
    i2c_write_cmd(0x8D);   /* charge pump */
    i2c_write_cmd(0x14);
    HAL_Delay(100);        /* wait for charge pump stabilisation */
    i2c_write_cmd(0x20);   /* memory mode: horizontal */
    i2c_write_cmd(0x00);
    i2c_write_cmd(0xA1);   /* segment remap: col 127 = SEG0 */
    i2c_write_cmd(0xC8);   /* COM scan: remapped */
    i2c_write_cmd(0xDA);   /* COM pins */
    i2c_write_cmd(0x12);
    i2c_write_cmd(0x81);   /* contrast */
    i2c_write_cmd(0xCF);
    i2c_write_cmd(0xD9);   /* pre-charge */
    i2c_write_cmd(0xF1);
    i2c_write_cmd(0xDB);   /* VCOM detect */
    i2c_write_cmd(0x40);
    i2c_write_cmd(0xA4);   /* resume display */
    i2c_write_cmd(0xA6);   /* normal (non-inverted) */
    i2c_write_cmd(0xAF);   /* display on */

    SSD1306_Clear();
    SSD1306_Flush();
}

void SSD1306_Clear(void)
{
    for (uint16_t i = 0; i < sizeof(fb); i++) fb[i] = 0x00;
}

void SSD1306_Flush(void)
{
    for (uint8_t page = 0; page < SSD1306_PAGES; page++) {
        i2c_write_cmd(0xB0 + page);   /* set page */
        i2c_write_cmd(0x00);          /* column low = 0 */
        i2c_write_cmd(0x10);          /* column high = 0 */
        i2c_write_data_buf(&fb[page * SSD1306_WIDTH], SSD1306_WIDTH);
    }
}

void SSD1306_FillRect(uint8_t x, uint8_t y, uint8_t w, uint8_t h, uint8_t color)
{
    if (x >= SSD1306_WIDTH || y >= SSD1306_HEIGHT) return;
    if (x + w > SSD1306_WIDTH)  w = SSD1306_WIDTH - x;
    if (y + h > SSD1306_HEIGHT) h = SSD1306_HEIGHT - y;

    for (uint8_t row = 0; row < h; row++) {
        uint8_t  py      = y + row;
        uint8_t  page    = py >> 3;
        uint8_t  bit     = py & 0x07;
        uint16_t idx     = (uint16_t)page * SSD1306_WIDTH + x;

        if (color) {
            for (uint8_t col = 0; col < w; col++)
                fb[idx + col] |= (1U << bit);
        } else {
            uint8_t mask = ~(1U << bit);
            for (uint8_t col = 0; col < w; col++)
                fb[idx + col] &= mask;
        }
    }
}

void SSD1306_DrawRect(uint8_t x, uint8_t y, uint8_t w, uint8_t h, uint8_t color)
{
    SSD1306_HLine(x, y, w, color);
    SSD1306_HLine(x, y + h - 1, w, color);
    SSD1306_VLine(x, y, h, color);
    SSD1306_VLine(x + w - 1, y, h, color);
}

void SSD1306_HLine(uint8_t x, uint8_t y, uint8_t w, uint8_t color)
{
    SSD1306_FillRect(x, y, w, 1, color);
}

void SSD1306_VLine(uint8_t x, uint8_t y, uint8_t h, uint8_t color)
{
    SSD1306_FillRect(x, y, 1, h, color);
}

void SSD1306_DrawChar(uint8_t x, uint8_t y, char c)
{
    if (c < 32 || c > 126) c = ' ';
    if (x + 8 > SSD1306_WIDTH || y + 8 > SSD1306_HEIGHT) return;

    const uint8_t *glyph = font8x8[(uint8_t)c - 32];

    for (uint8_t col = 0; col < 8; col++) {
        uint8_t col_data = glyph[col];
        for (uint8_t row = 0; row < 8; row++) {
            if (col_data & (1U << row)) {
                uint8_t  py   = y + row;
                uint8_t  page = py >> 3;
                uint8_t  bit  = py & 0x07;
                uint16_t idx  = (uint16_t)page * SSD1306_WIDTH + (x + col);
                fb[idx] |= (1U << bit);
            }
        }
    }
}

void SSD1306_DrawString(uint8_t x, uint8_t y, const char *s)
{
    while (*s) {
        SSD1306_DrawChar(x, y, *s++);
        x += 8;
        if (x >= SSD1306_WIDTH) break;
    }
}

void SSD1306_DrawNumber(uint8_t x, uint8_t y, uint8_t num)
{
    if (num > 99) num = 99;
    SSD1306_DrawChar(x, y, '0' + (num / 10));
    SSD1306_DrawChar(x + 8, y, '0' + (num % 10));
}
